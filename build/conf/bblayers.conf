## build/conf/bblayers.conf
```bitbake
# POKY_BBLAYERS_CONF_VERSION is increased each time build/conf/bblayers.conf
# changes incompatibly
POKY_BBLAYERS_CONF_VERSION = "2"

BBPATH = "${TOPDIR}"
BBFILES ?= ""

BBLAYERS ?= " \
  /home/jon/src/jmagnuson/yocto/rpi0/layers/poky/meta \
  /home/jon/src/jmagnuson/yocto/rpi0/layers/poky/meta-poky \
  /home/jon/src/jmagnuson/yocto/rpi0/layers/poky/meta-yocto-bsp \
  /home/jon/src/jmagnuson/yocto/rpi0/layers/meta-openembedded/meta-oe \
  /home/jon/src/jmagnuson/yocto/rpi0/layers/meta-openembedded/meta-python \
  /home/jon/src/jmagnuson/yocto/rpi0/layers/meta-raspberrypi \
  /home/jon/src/jmagnuson/yocto/rpi0/layers/meta-openembedded/meta-networking \
  /home/jon/src/jmagnuson/yocto/rpi0/layers/meta-openembedded/meta-multimedia \
  /home/jon/src/jmagnuson/yocto/rpi0/layers/meta-openembedded/meta-filesystems \
  /home/jon/src/jmagnuson/yocto/rpi0/layers/meta-virtualization \
  /home/jon/src/jmagnuson/yocto/rpi0/meta-rpi0 \
  /home/jon/src/jmagnuson/yocto/rpi0/layers/meta-rust-bin \
  /home/jon/src/jmagnuson/yocto/rpi0/layers/meta-docker \
  /home/jon/src/jmagnuson/yocto/rpi0/layers/meta-gnss-sdr \
  /home/jon/src/jmagnuson/yocto/rpi0/layers/meta-sdr \
  /home/jon/src/jmagnuson/yocto/rpi0/layers/meta-qt5 \
  "
```

## meta-rpi0/conf/layer.conf
```bitbake
# We have a conf and classes directory, append to BBPATH
BBPATH .= ":${LAYERDIR}"

# We have a recipes directory containing .bb and .bbappend files, add to BBFILES
BBFILES += "${LAYERDIR}/recipes*/*/*.bb \
            ${LAYERDIR}/recipes*/*/*.bbappend"

BBFILE_COLLECTIONS += "rpi0"
BBFILE_PATTERN_rpi0 := "^${LAYERDIR}/"
BBFILE_PRIORITY_rpi0 = "6"

LAYERSERIES_COMPAT_raspberrypi = "sumo thud warrior zeus"

# Additional license directories.
#LICENSE_PATH += "${LAYERDIR}/files/custom-licenses"
```
